/*###ICF### Section handled by ICF editor, don't touch! ****/
/*-Editor annotation file-*/
/* IcfEditorFile="$TOOLKIT_DIR$\config\ide\IcfEditor\cortex_v1_4.xml" */
/*-Specials-*/
/*************************************************************/
/*   Scatter-Loading Description File generated by HUGE-IC   */
/*   notice : sram 0x20000000 remmaping to 0x10000000        */
/*            RW_SRAM0, RW_SRAM10 use for code run & varibles*/
/*	      [0x2000e000, 0x2000e200] is rom var, be careful*/
/*                 not use for code, best use: stack or var  */
/*************************************************************/

define symbol __INTVEC_START__      = 0x10006000;
/*-Memory Regions-*/
define symbol __CODE_START__        = 0x10006000;
define symbol __CODE_END__          = 0x1000DFFF;
define symbol __STACK_START__       = 0x2000E000;
define symbol __STACK_END__         = 0x2000E3FF;
define symbol __SRAM10_START__      = 0x2000E400;
define symbol __SRAM10_END__        = 0x2000FFFF;
define symbol __SRAM0_START__       = 0x20000000;
define symbol __SRAM0_END__         = 0x20005FFF;
define symbol __SRAM1_START__       = 0x20010000;
define symbol __SRAM1_END__         = 0x20011FFF;
define symbol __SRAM2_START__       = 0x20012000;
define symbol __SRAM2_END__         = 0x20013FFF;
define symbol __SRAM3_START__       = 0x20014000;
define symbol __SRAM3_END__         = 0x20015FFF;
define symbol __SRAM4_START__       = 0x20016000;
define symbol __SRAM4_END__         = 0x200167FF;
define symbol __SRAM5_START__       = 0x20016800;
define symbol __SRAM5_END__         = 0x20016FFF;
define symbol __SRAM6_START__       = 0x20017000;
define symbol __SRAM6_END__         = 0x200177FF;
define symbol __SRAM7_START__       = 0x20017800;
define symbol __SRAM7_END__         = 0x20017FFF;
define symbol __SRAM8_START__       = 0x20018000;
define symbol __SRAM8_END__         = 0x200187FF;
define symbol __SRAM9_START__       = 0x20018800;
define symbol __SRAM9_END__         = 0x20018FFF;
define symbol __SRAM11_START__      = 0x20019000;
define symbol __SRAM11_END__        = 0x200197FF;
define symbol __SRAM12_START__      = 0x20019800;
define symbol __SRAM12_END__        = 0x20019FFF;
define symbol __SRAM13_START__      = 0x2001A000;
define symbol __SRAM13_END__        = 0x2001A7FF;
define symbol __SRAM14_START__      = 0x2001A800;
define symbol __SRAM14_END__        = 0x2001AFFF;
define symbol __SRAM15_START__      = 0x2001B000;
define symbol __SRAM15_END__        = 0x2001B7FF;
define symbol __SRAM16_START__      = 0x2001B800;
define symbol __SRAM16_END__        = 0x2001BFFF;

/*-Sizes-*/
define symbol __SIZE_CSTACK__       = 0x400;
define symbol __SIZE_PROC_STACK__   = 0x0;
define symbol __SIZE_HEAP__         = 0x0;
/**** End of ICF editor section. ###ICF###*/

define memory mem with size = 4G;

define region CODE_REGION       = mem:[from __CODE_START__ to __CODE_END__];
define region STACK_REGION      = mem:[from __STACK_START__ to __STACK_END__];
define region SRAM10_REGION     = mem:[from __SRAM10_START__ to __SRAM10_END__];
define region SRAM0_REGION      = mem:[from __SRAM0_START__ to __SRAM0_END__];
define region SRAM1_REGION      = mem:[from __SRAM1_START__ to __SRAM1_END__];
define region SRAM2_REGION      = mem:[from __SRAM2_START__ to __SRAM2_END__];
define region SRAM3_REGION      = mem:[from __SRAM3_START__ to __SRAM3_END__];
define region SRAM4_5_REGION    = mem:[from __SRAM4_START__ to __SRAM5_END__];
define region SRAM6_7_REGION    = mem:[from __SRAM6_START__ to __SRAM7_END__];
define region SRAM8_9_REGION    = mem:[from __SRAM8_START__ to __SRAM9_END__];
define region SRAM11_REGION     = mem:[from __SRAM11_START__ to __SRAM11_END__];
define region SRAM12_13_REGION  = mem:[from __SRAM12_START__ to __SRAM13_END__];
define region SRAM14_REGION     = mem:[from __SRAM14_START__ to __SRAM14_END__];
define region SRAM15_REGION     = mem:[from __SRAM15_START__ to __SRAM15_END__];
define region SRAM16_REGION     = mem:[from __SRAM16_START__ to __SRAM16_END__];

define block CSTACK     with alignment = 16, size = __SIZE_CSTACK__     { };
define block PROC_STACK with alignment = 8,  size = __SIZE_PROC_STACK__ { };
define block HEAP       with alignment = 8,  size = __SIZE_HEAP__       { };

do not initialize  { section .noinit };
initialize by copy { readwrite };
if (isdefinedsymbol(__USE_DLIB_PERTHREAD))
{
  // Required in a multi-threaded application
  initialize by copy with packing = none { section __DLIB_PERTHREAD };
}

place at address mem:__INTVEC_START__ { readonly section .intvec };

place in CODE_REGION        { readonly, section application_specific_ro};
place in STACK_REGION       { block CSTACK, block PROC_STACK, block HEAP};
place in SRAM10_REGION      { readwrite, section application_specific_rw, section SRAM10};
place in SRAM0_REGION       { section application_specific_rw, section SRAM0};
place in SRAM1_REGION       { section SRAM1};
place in SRAM2_REGION       { section SRAM2};
place in SRAM3_REGION       { section SRAM3};
place in SRAM4_5_REGION     { section SRAM4_5};
place in SRAM6_7_REGION     { section SRAM6_7};
place in SRAM8_9_REGION     { section SRAM8_9};
place in SRAM11_REGION      { section SRAM11};
place in SRAM12_13_REGION   { section SRAM12_13};
place in SRAM14_REGION      { section SRAM14};
place in SRAM15_REGION      { section SRAM15};
place in SRAM16_REGION      { section SRAM16};
